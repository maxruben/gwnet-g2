## CMakeLists.txt
```
#-------------------------------------------------------------------------------
# Zephyr Example Application
#
# Copyright (c) 2021 Nordic Semiconductor ASA
# SPDX-License-Identifier: Apache-2.0

cmake_minimum_required(VERSION 3.20.0)
find_package(Zephyr REQUIRED HINTS $ENV{ZEPHYR_BASE})

project(app LANGUAGES C VERSION 1.0.0)

configure_file(app_version.h.in ${CMAKE_BINARY_DIR}/app/include/app_version.h)

target_sources(app PRIVATE src/main.c)

# Add include directory for board specific CAF def files
zephyr_include_directories(
  configuration/${BOARD}
  )

target_sources_ifdef(CONFIG_CAF_SAMPLE_LED_STATE
  app PRIVATE src/modules/led_state.c)
```

## Kconfig
```
# Copyright (c) 2021 Nordic Semiconductor ASA
# SPDX-License-Identifier: Apache-2.0
#
# This file is the application Kconfig entry point. All application Kconfig
# options can be defined here or included via other application Kconfig files.
# You can browse these options using the west targets menuconfig (terminal) or
# guiconfig (GUI).

menu "Common Application Framework sample"
rsource "src/modules/Kconfig"
endmenu

menu "Zephyr Kernel"
source "Kconfig.zephyr"
endmenu
```

## prj.conf
```kconfig
# Copyright (c) 2021 Nordic Semiconductor ASA
# SPDX-License-Identifier: Apache-2.0
#
# This file contains selected Kconfig options for the application.

# Dependencies for APP_EVENT_MANAGER and CAF
CONFIG_HEAP_MEM_POOL_SIZE=2048

# Enable CAF_BUTTONS
CONFIG_CAF=y
CONFIG_CAF_BUTTONS=y
CONFIG_CAF_BUTTONS_POLARITY_INVERSED=y

# Dependencies for CAF_LEDS
CONFIG_LED=y
CONFIG_PWM=y
CONFIG_LED_PWM=y

# Enable CAF_LEDS
CONFIG_CAF_LEDS=y
CONFIG_CAF_LEDS_PWM=y

# Enable logging
CONFIG_LOG=y
# Increase number of internal logging buffers

# Application specific options
CONFIG_CAF_SAMPLE_LED_STATE=y
```

## src/main.c
```c
/*
 * Copyright (c) 2021 Nordic Semiconductor ASA
 *
 * SPDX-License-Identifier: LicenseRef-Nordic-5-Clause
 */
#include <app_event_manager.h>

#define MODULE main
#include <caf/events/module_state_event.h>

#include <zephyr/logging/log.h>
LOG_MODULE_REGISTER(MODULE);

void main(void) {
  LOG_INF("Starting GWNET-G2 CAF application...");
  if (app_event_manager_init()) {
    LOG_ERR("Application Event Manager not initialized");
  } else {
    module_set_state(MODULE_STATE_READY);
  }
}
```
